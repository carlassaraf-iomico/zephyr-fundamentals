## tests/custom_led/testcase.yaml
```yaml
common:
  tags: homework
  platform_allow:
    - native_sim
    - qemu_x86
  integration_platforms:
    - native_sim
tests:
  homework.l6_task1: {}
  homework.l6_task2:
    extra_args: TEST_TASK2=1
```

## tests/custom_led_shell/testcase.yaml
```yaml
common:
  tags: homework
  platform_allow:
    - native_sim
    - qemu_x86
  integration_platforms:
    - native_sim
tests:
  homework.l7_task1: {}
  homework.l7_task2:
    extra_args: TEST_TASK2=1
```
