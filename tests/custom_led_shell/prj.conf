## CMakeLists.txt
```
# SPDX-License-Identifier: Apache-2.0
# Builds the student's driver module from app/modules/, as the course's app does.
cmake_minimum_required(VERSION 3.20.0)

list(APPEND ZEPHYR_EXTRA_MODULES ${CMAKE_CURRENT_LIST_DIR}/../../app/modules)
list(APPEND DTS_ROOT ${CMAKE_CURRENT_LIST_DIR}/../../app/modules)
find_package(Zephyr REQUIRED HINTS $ENV{ZEPHYR_BASE})
project(custom_led_shell_test)

target_sources(app PRIVATE src/test_task1.c)
# task2 scenarios add the extension API / set command tests (testcase.yaml: TEST_TASK2=1)
if(TEST_TASK2)
  target_sources(app PRIVATE src/test_task2.c)
endif()
```

## prj.conf
```kconfig
CONFIG_ZTEST=y
CONFIG_GPIO=y
CONFIG_GPIO_EMUL=y
CONFIG_SENSOR=y
CONFIG_CUSTOM_LED=y
CONFIG_SHELL=y
CONFIG_SHELL_BACKEND_SERIAL=n
CONFIG_SHELL_BACKEND_DUMMY=y
CONFIG_SHELL_PROMPT_DUMMY=""
CONFIG_SENSOR_SHELL=n
CONFIG_CUSTOM_LED_SHELL=y
CONFIG_LOG=n
```

## boards/qemu_x86.overlay
```dts
/* qemu_x86 has no GPIO: add the emulator native_sim has, to run the test locally.
 * A board overlay replaces app.overlay, so include it. */
#include "../app.overlay"

/ {
	gpio0: gpio_emul {
		status = "okay";
		compatible = "zephyr,gpio-emul";
		rising-edge;
		falling-edge;
		high-level;
		low-level;
		gpio-controller;
		#gpio-cells = <2>;
	};
};
```

## src/test_task1.c
```c
/*
 * l7-task1: the `sensor` shell command (fetch, read, info), run through the shell's
 * dummy backend. The LED is pin 5 of an emulated GPIO controller (app.overlay).
 */
#include <ctype.h>
#include <string.h>
#include <zephyr/ztest.h>
#include <zephyr/drivers/gpio.h>
#include <zephyr/drivers/gpio/gpio_emul.h>
#include <zephyr/shell/shell.h>
#include <zephyr/shell/shell_dummy.h>

#define LED_NODE DT_NODELABEL(custom_led)

static const struct device *const dev = DEVICE_DT_GET(LED_NODE);
static const struct gpio_dt_spec pin = GPIO_DT_SPEC_GET(LED_NODE, gpios);

int led_level(void)
{
	return gpio_emul_output_get(pin.port, pin.pin);
}

/* The dummy backend records line breaks even when a command prints nothing. */
static bool has_text(const char *out)
{
	for (; *out; out++) {
		if (isalnum((unsigned char)*out)) {
			return true;
		}
	}
	return false;
}

/* Runs a shell command; returns its result and leaves its output in *out. */
int run(const char *cmd, const char **out)
{
	const struct shell *sh = shell_backend_dummy_get_ptr();
	size_t size;
	int ret;

	shell_backend_dummy_clear_output(sh);
	ret = shell_execute_cmd(sh, cmd);
	*out = shell_backend_dummy_get_output(sh, &size);
	return ret;
}

ZTEST(custom_led_shell, test_fetch_turns_led_on)
{
	const char *out;

	zassert_ok(run("sensor read", &out));
	zassert_ok(run("sensor fetch", &out), "`sensor fetch` failed");
	zassert_equal(led_level(), 1, "the LED is off after `sensor fetch`");
}

ZTEST(custom_led_shell, test_read_turns_led_off_and_prints)
{
	const char *out;

	zassert_ok(run("sensor fetch", &out));
	zassert_ok(run("sensor read", &out), "`sensor read` failed");
	zassert_equal(led_level(), 0, "the LED is on after `sensor read`");
	zassert_true(has_text(out), "`sensor read` prints nothing");
}

ZTEST(custom_led_shell, test_info_prints_name_and_ready)
{
	const char *out;

	zassert_ok(run("sensor info", &out), "`sensor info` failed");
	zassert_not_null(strstr(out, dev->name), "`sensor info` doesn't print the device name (%s)", dev->name);
	zassert_not_null(strstr(out, "ready"), "`sensor info` doesn't print the ready state");
}

static void *setup(void)
{
	k_usleep(10); /* let the shell backend start */
	return NULL;
}

ZTEST_SUITE(custom_led_shell, NULL, setup, NULL, NULL, NULL);
```

## src/test_task2.c
```c
/* l7-task2: `sensor set <ms>` passes a valid period to the extension API and rejects the rest. */
#include <zephyr/ztest.h>
#include <custom_led/custom_led.h>

static const struct device *const dev = DEVICE_DT_GET(DT_NODELABEL(custom_led));

int run(const char *cmd, const char **out);

ZTEST(custom_led_set, test_set_valid_period)
{
	const char *out;

	zassert_ok(run("sensor set 250", &out), "`sensor set 250` failed");
	zassert_equal(custom_led_get_period(dev), 250, "`sensor set 250` didn't set the period to 250");
}

ZTEST(custom_led_set, test_set_rejects_missing_value)
{
	const char *out;

	zassert_not_equal(run("sensor set", &out), 0, "`sensor set` with no value succeeds");
}

ZTEST(custom_led_set, test_set_rejects_out_of_range)
{
	const char *out;

	zassert_ok(run("sensor set 300", &out));
	zassert_not_equal(run("sensor set 99", &out), 0, "`sensor set 99` (below 100) succeeds");
	zassert_not_equal(run("sensor set 5001", &out), 0, "`sensor set 5001` (above 5000) succeeds");
	zassert_equal(custom_led_get_period(dev), 300, "a rejected value changed the period");
}

ZTEST(custom_led_set, test_set_rejects_non_number)
{
	const char *out;

	zassert_not_equal(run("sensor set abc", &out), 0, "`sensor set abc` succeeds");
}

ZTEST_SUITE(custom_led_set, NULL, NULL, NULL, NULL, NULL);
```
