## boards/iomico/mcxa153/Kconfig.mcxa153
```kconfig
config BOARD_MCXA153
	select SOC_MCXA153 if BOARD_MCXA153
	select SOC_PART_NUMBER_MCXA153VLH
```

## boards/iomico/mcxa153/board.yml
```yaml
board:
  name: mcxa153
  full_name: MCXA153
  vendor: iomico
  socs:
  - name: mcxa153
```

## boards/iomico/mcxa153/mcxa153_defconfig
```kconfig
CONFIG_CONSOLE=y
CONFIG_UART_CONSOLE=y
CONFIG_SERIAL=y
CONFIG_UART_INTERRUPT_DRIVEN=y
CONFIG_GPIO=y
CONFIG_BOARD_EARLY_INIT_HOOK=y
```
