## CMakeLists.txt
```
# SPDX-License-Identifier: Apache-2.0
# Builds the student's driver module from app/modules/, as the course's app does.
cmake_minimum_required(VERSION 3.20.0)

list(APPEND ZEPHYR_EXTRA_MODULES ${CMAKE_CURRENT_LIST_DIR}/../../app/modules)
list(APPEND DTS_ROOT ${CMAKE_CURRENT_LIST_DIR}/../../app/modules)
find_package(Zephyr REQUIRED HINTS $ENV{ZEPHYR_BASE})
project(custom_led_test)

target_sources(app PRIVATE src/test_task1.c)
# task2 scenarios add the extension API / set command tests (testcase.yaml: TEST_TASK2=1)
if(TEST_TASK2)
  target_sources(app PRIVATE src/test_task2.c)
endif()
```

## prj.conf
```kconfig
CONFIG_ZTEST=y
CONFIG_GPIO=y
CONFIG_GPIO_EMUL=y
CONFIG_SENSOR=y
CONFIG_CUSTOM_LED=y
```

## app.overlay
```dts
/* The LED under test: pin 5 of the emulated GPIO controller. */
#include <zephyr/dt-bindings/gpio/gpio.h>

/ {
	custom_led: custom-led {
		compatible = "course,custom-led";
		gpios = <&gpio0 5 GPIO_ACTIVE_HIGH>;
	};
};
```

## src/test_task1.c
```c
/*
 * l6-task1: the LED sensor driver. sensor_sample_fetch() turns the LED on and
 * sensor_channel_get() turns it off. The LED is pin 5 of an emulated GPIO controller
 * (app.overlay), so the test reads the pin the driver drives.
 */
#include <zephyr/ztest.h>
#include <zephyr/drivers/sensor.h>
#include <zephyr/drivers/gpio.h>
#include <zephyr/drivers/gpio/gpio_emul.h>

#define LED_NODE DT_NODELABEL(custom_led)

static const struct device *const dev = DEVICE_DT_GET(LED_NODE);
static const struct gpio_dt_spec pin = GPIO_DT_SPEC_GET(LED_NODE, gpios);

static int led_level(void)
{
	return gpio_emul_output_get(pin.port, pin.pin);
}

static void fetch(void)
{
	zassert_ok(sensor_sample_fetch(dev), "sensor_sample_fetch() failed");
}

static void channel_get(void)
{
	struct sensor_value val;

	zassert_ok(sensor_channel_get(dev, SENSOR_CHAN_ALL, &val), "sensor_channel_get() failed");
}

ZTEST(custom_led, test_device_ready)
{
	zassert_true(device_is_ready(dev), "the course,custom-led device is not ready");
}

ZTEST(custom_led, test_fetch_turns_led_on)
{
	channel_get();
	fetch();
	zassert_equal(led_level(), 1, "the LED is off after sensor_sample_fetch()");
}

ZTEST(custom_led, test_fetch_twice_keeps_led_on)
{
	/* A toggle gives different levels on two calls in a row, whatever the start. */
	fetch();
	zassert_equal(led_level(), 1, "the LED is off after sensor_sample_fetch()");
	fetch();
	zassert_equal(led_level(), 1, "the LED is off after a second sensor_sample_fetch() (a toggle?)");
}

ZTEST(custom_led, test_channel_get_turns_led_off)
{
	fetch();
	channel_get();
	zassert_equal(led_level(), 0, "the LED is on after sensor_channel_get()");
}

ZTEST(custom_led, test_channel_get_twice_keeps_led_off)
{
	channel_get();
	zassert_equal(led_level(), 0, "the LED is on after sensor_channel_get()");
	channel_get();
	zassert_equal(led_level(), 0, "the LED is on after a second sensor_channel_get() (a toggle?)");
}

ZTEST_SUITE(custom_led, NULL, NULL, NULL, NULL, NULL);
```

## src/test_task2.c
```c
/* l6-task2: the extension API stores the blink period in the driver's data. */
#include <zephyr/ztest.h>
#include <custom_led/custom_led.h>

static const struct device *const dev = DEVICE_DT_GET(DT_NODELABEL(custom_led));

ZTEST(custom_led_period, test_set_then_get_period)
{
	zassert_ok(custom_led_set_period(dev, 250), "custom_led_set_period(dev, 250) failed");
	zassert_equal(custom_led_get_period(dev), 250, "custom_led_get_period() doesn't return 250");
	zassert_ok(custom_led_set_period(dev, 1000), "custom_led_set_period(dev, 1000) failed");
	zassert_equal(custom_led_get_period(dev), 1000, "custom_led_get_period() doesn't return 1000");
}

ZTEST_SUITE(custom_led_period, NULL, NULL, NULL, NULL, NULL);
```
